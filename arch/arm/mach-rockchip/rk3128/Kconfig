## arch/arm/mach-rockchip/rk3128/Kconfig
```kconfig
if ROCKCHIP_RK3128

choice
	prompt "RK3128 board select"

config TARGET_EVB_RK3128
	bool "RK3128 evaluation board"
	select BOARD_LATE_INIT
	help
	  RK3128evb is a evaluation board for Rockchip rk3128,
	  with full function and phisical connectors support like
	  usb2.0 host ports, LVDS, JTAG, MAC, SDcard, HDMI, USB-2-serial...

endchoice

config ROCKCHIP_BOOT_MODE_REG
	default 0x100a0038

config ROCKCHIP_STIMER_BASE
	default 0x200440a0

config RAM_ROCKCHIP_DEBUG
	default n

config SPL_PAD_TO
	default 0x7f8000

config OF_SPL_REMOVE_PROPS
	default "clock-names interrupt-parent assigned-clocks assigned-clock-rates assigned-clock-parents"

config SYS_SOC
	default "rk3128"

config TPL_FRAMEWORK
	default n if TPL

config TPL_MAX_SIZE
	default 0x1800 if TPL

config TPL_STACK
	default 0x10082000 if TPL

config TPL_TEXT_BASE
        default 0x10080800 if TPL

config TPL_SYS_MALLOC_F_LEN
	default 0x0 if TPL

source "board/rockchip/evb_rk3128/Kconfig"

endif
```

## board/geniatech/xpi-3128_rk3128/Kconfig
```kconfig
if TARGET_XPI_3128_RK3128

config SYS_BOARD
	default "xpi-3128_rk3128"

config SYS_VENDOR
	default "geniatech"

config SYS_CONFIG_NAME
	default "xpi-3128-rk3128"

endif
```

## configs/xpi-3128-rk3128_defconfig
```kconfig
CONFIG_ARM=y
CONFIG_ARCH_ROCKCHIP=y
CONFIG_SPL_GPIO=y
CONFIG_DEFAULT_DEVICE_TREE="rockchip/rk3128-xpi-3128"
CONFIG_ROCKCHIP_RK3128=y
CONFIG_TARGET_XPI_3128_RK3128=y
CONFIG_SYS_LOAD_ADDR=0x60800800
CONFIG_DEBUG_UART_BASE=0x20064000
CONFIG_DEBUG_UART_CLOCK=24000000
CONFIG_DEBUG_UART=y
# CONFIG_ANDROID_BOOT_IMAGE is not set
CONFIG_FIT_VERBOSE=y
CONFIG_DEFAULT_FDT_FILE="rockchip/rk3128-xpi-3128.dtb"
# CONFIG_DISPLAY_CPUINFO is not set
CONFIG_DISPLAY_BOARDINFO_LATE=y
# CONFIG_SPL_RAW_IMAGE_SUPPORT is not set
CONFIG_SPL_POWER=y
# CONFIG_CMD_BIND is not set
CONFIG_CMD_GPIO=y
CONFIG_CMD_GPIO_READ=y
CONFIG_CMD_GPT=y
CONFIG_CMD_I2C=y
CONFIG_CMD_MMC=y
CONFIG_CMD_USB=y
CONFIG_CMD_ROCKUSB=y
# CONFIG_CMD_SETEXPR is not set
CONFIG_CMD_REGULATOR=y
CONFIG_FASTBOOT_BUF_ADDR=0x60800800
CONFIG_SPL_DM_GPIO_LOOKUP_LABEL=y
CONFIG_ROCKCHIP_GPIO=y
CONFIG_SYS_I2C_ROCKCHIP=y
CONFIG_LED=y
CONFIG_LED_GPIO=y
CONFIG_SUPPORT_EMMC_RPMB=y
CONFIG_MMC_DW=y
CONFIG_MMC_DW_ROCKCHIP=y
CONFIG_PHY_ROCKCHIP_INNO_USB2=y
CONFIG_SPL_DM_REGULATOR=y
CONFIG_REGULATOR_PWM=y
CONFIG_SPL_DM_REGULATOR_FIXED=y
CONFIG_PWM_ROCKCHIP=y
CONFIG_DEBUG_UART_SHIFT=2
CONFIG_SYS_NS16550_MEM32=y
CONFIG_SYSRESET=y
CONFIG_USB=y
CONFIG_DM_USB_GADGET=y
CONFIG_USB_EHCI_HCD=y
CONFIG_USB_EHCI_GENERIC=y
CONFIG_USB_DWC2=y
CONFIG_USB_GADGET=y
CONFIG_USB_FUNCTION_ROCKUSB=y
CONFIG_ERRNO_STR=y
CONFIG_OF_LIBFDT_ASSUME_MASK=0
```
